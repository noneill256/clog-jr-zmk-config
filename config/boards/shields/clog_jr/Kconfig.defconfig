## config/boards/shields/clog_jr/Kconfig.defconfig
```kconfig
# Copyright (c) 2022 The ZMK Contributors
# SPDX-License-Identifier: MIT

if SHIELD_CLOG_JR_DONGLE

config ZMK_KEYBOARD_NAME
    default "Clog Jr"
    
config ZMK_SPLIT_ROLE_CENTRAL
    default y

endif

if SHIELD_CLOG_JR_DONGLE || SHIELD_CLOG_JR_LEFT || SHIELD_CLOG_JR_RIGHT

config ZMK_SPLIT
    default y

endif
```

## config/boards/shields/clog_jr/Kconfig.shield
```kconfig
# Copyright (c) 2022 The ZMK Contributors
# SPDX-License-Identifier: MIT

config SHIELD_CLOG_JR
    bool

config SHIELD_CLOG_JR_DONGLE
	def_bool $(shields_list_contains,clog_jr_dongle)

config SHIELD_CLOG_JR_LEFT
    def_bool $(shields_list_contains,clog_jr_left)
    // select SHIELD_CLOG_JR

config SHIELD_CLOG_JR_RIGHT
    def_bool $(shields_list_contains,clog_jr_right)
    // select SHIELD_CLOG_JR
```
